## Kconfig
```kconfig
choice
    prompt "Choose target architecture"

config CORTEX_M4
    bool "Cortex-M4"

endchoice

config BOARD_SPECIFIC_HEADER
    string "Path to board specific header"
    help
        The board specific header contains board specific configurations which
        are used by the codebase

choice
    prompt "Choose vendor drivers to compile"

config USE_STM32_DRIVERS
    bool "STM32 Drivers"

endchoice

source "drivers/Kconfig"
source "application/Kconfig"
```

## application/Kconfig
```kconfig
menu "Application"

menu "Temperature Monitoring"
config TEMPERATURE_MONITORING_MIN_THRESHOLD
    int "Minimum temperature in which the system can work, given in Celsius"
    default -15
    help
        If the device's internal temperature reaches this value, the system is
        put into fault state

config TEMPERATURE_MONITORING_MAX_THRESHOLD
    int "Maximum temperature in which the system can work, given in Celsius"
    default 70
    help
        If the device's internal temperature reaches this value, the system is
        put into fault state

config TEMPERATURE_MONITORING_INTERVAL
    int "Interval in which the temperature is checked, given in milliseconds"
    default 1000
    help
        The device's internal temperature is checked regularly and compared
        against the minimum and maximum configured tresholds. This option gives
        you the ability to choose what's the interval in which the temperature
        is checked

config TEMPERATURE_MONITORING_HOLD_OFF_TIME
    int "Time to wait before going to fault state, given in milliseconds"
    default 5000
    help
        If the device's internal temperature exceeds the configured thresholds,
        the system goes into fault state. This option sets the amount of time
        between the moment the critical temperature is detected and the moment
        the system is put in fault state. The temperature keeps being checked in
        case the hold off time value is greater then the monitoring interval,
        which gives a chance for the system temperature to lower before going
        into fault state
endmenu

endmenu
```

## drivers/Kconfig
```kconfig
menu "Drivers"

source "drivers/adc/Kconfig"
source "drivers/gpio/Kconfig"

endmenu
```

## drivers/adc/Kconfig
```kconfig
menu "ADC"

choice
    prompt "Choose the analog digital converter driver for your target"
    default STM32_ADC_DRIVER if USE_STM32_DRIVERS

config STM32_ADC_DRIVER
    bool "ADC driver for STM32 devices"

endchoice

endmenu
```

## drivers/clock/Kconfig
```kconfig
menu "Clock"

choice
    prompt "Choose the clock driver for your target"
    default STM32_CLOCK_DRIVER if USE_STM32_DRIVERS

config STM32_CLOCK_DRIVER
    bool "Clock driver for STM32 devices"

endchoice

endmenu
```

## drivers/gpio/Kconfig
```kconfig
menu "GPIO"

choice
    prompt "Choose the GPIO driver for your target"
    default STM32_GPIO_DRIVER if USE_STM32_DRIVERS

config STM32_GPIO_DRIVER
    bool "GPIO Driver for STM32 devices"

endchoice

endmenu
```
